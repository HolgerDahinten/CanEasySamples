VERSION ""

NS_ :

BS_:

BU_: MyNode

BO_ 0 MyMsg: 8 MyNode
 SG_ MySig : 0|8@1+ (0.5,0) [0|0] "" Vector__XXX

EV_ MyVarData: 0 [0|0] "" 0 1 DUMMY_NODE_VECTOR0 Vector__XXX;

EV_ MyVarString: 0 [0|0] "" 0 2 DUMMY_NODE_VECTOR8000 Vector__XXX;

EV_ MyVarFloat: 1 [0|0] "" 0 3 DUMMY_NODE_VECTOR0 Vector__XXX;

EV_ MyVarInt: 0 [0|0] "" 0 4 DUMMY_NODE_VECTOR0 Vector__XXX;
ENVVAR_DATA_ MyVarData: 0;

BA_DEF_ BU_  "NodeLayerModules" STRING ;
BA_DEF_DEF_  "NodeLayerModules" "CANoeILNLVector.dll";
